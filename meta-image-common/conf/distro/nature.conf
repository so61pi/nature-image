## meta-image-common/conf/distro/nature.conf
```bitbake
DISTRO                  = "nature"
DISTRO_NAME             = "nature distribution"
DISTRO_VERSION          = "1.0"
DISTRO_CODENAME         = "nature"
DISTRO_FEATURES_DEFAULT = "systemd pam usrmerge"

IMAGE_INSTALL_append = " systemd libpam "
EXTRA_IMAGE_FEATURES_append = " read-only-rootfs "
ROOT_HOME = "/root"

MAINTAINER = "so61pi"

# SDK_VENDOR = "-nature"
# SDK_VERSION := "${@'${DISTRO_VERSION}'.replace('snapshot-${DATE}','snapshot')}"
# SDK_NAME = "${DISTRO}-${TCLIBC}-${SDK_ARCH}-${IMAGE_BASENAME}-${TUNE_PKGARCH}"
# SDKPATH = "/opt/${DISTRO}/${SDK_VERSION}"

DISTRO_FEATURES = "${DISTRO_FEATURES_DEFAULT} ${DISTRO_FEATURES_LIBC}"

#
# libc configuration
#
# These configurations are already set in openembedded-core/meta/conf/distro/defaultsetup.conf
# but we put it here for visibility and preventing surprising things from happening.
#
TCMODE = "default"
TCLIBC = "glibc"
TCLIBCAPPEND = ""

QEMU_TARGETS = "arm aarch64 i386 x86_64 mips mipsel mips64 mips64el ppc"

PREMIRRORS ??= "\
bzr://.*/.*   http://downloads.yoctoproject.org/mirror/sources/ \n \
cvs://.*/.*   http://downloads.yoctoproject.org/mirror/sources/ \n \
git://.*/.*   http://downloads.yoctoproject.org/mirror/sources/ \n \
gitsm://.*/.* http://downloads.yoctoproject.org/mirror/sources/ \n \
hg://.*/.*    http://downloads.yoctoproject.org/mirror/sources/ \n \
osc://.*/.*   http://downloads.yoctoproject.org/mirror/sources/ \n \
p4://.*/.*    http://downloads.yoctoproject.org/mirror/sources/ \n \
svn://.*/.*   http://downloads.yoctoproject.org/mirror/sources/ \n \
"

MIRRORS =+ "\
ftp://.*/.*      http://downloads.yoctoproject.org/mirror/sources/ \n \
http://.*/.*     http://downloads.yoctoproject.org/mirror/sources/ \n \
https://.*/.*    http://downloads.yoctoproject.org/mirror/sources/ \n \
"

# The CONNECTIVITY_CHECK_URI's are used to test whether we can succesfully
# fetch from the network (and warn you if not). To disable the test set
# the variable to be empty.
# Git example url: git://git.yoctoproject.org/yocto-firewall-test;protocol=git;rev=master
CONNECTIVITY_CHECK_URIS = "https://www.example.com/"

SANITY_TESTED_DISTROS = "   \
    ubuntu-15.04  \n \
    ubuntu-16.04  \n \
    ubuntu-16.10  \n \
    fedora-24     \n \
    fedora-25     \n \
    centos-7      \n \
    debian-8      \n \
    opensuse-42.1 \n \
    opensuse-42.2 \n \
    "

#
# OELAYOUT_ABI allows us to notify users when the format of TMPDIR changes in 
# an incompatible way. Such changes should usually be detailed in the commit
# that breaks the format and have been previously discussed on the mailing list 
# with general agreement from the core team.
#
OELAYOUT_ABI = "12"


# QA check settings - a little stricter than the OE-Core defaults
WARN_TO_ERROR_QA = "already-stripped compile-host-path install-host-path \
                    installed-vs-shipped ldflags pn-overrides rpaths staticdev \
                    useless-rpaths"
WARN_QA_remove = "${WARN_TO_ERROR_QA}"
ERROR_QA_append = " ${WARN_TO_ERROR_QA}"

require conf/distro/include/no-static-libs.inc
```

## meta-image-common/conf/layer.conf
```bitbake
# We have a conf and classes directory, add to BBPATH
BBPATH .= ":${LAYERDIR}"

# We have recipes-* directories, add to BBFILES
BBFILES += "${LAYERDIR}/recipes-*/*/*.bb        \
            ${LAYERDIR}/recipes-*/*/*.bbappend  \
            "

BBFILE_COLLECTIONS += "image-common"
BBFILE_PATTERN_image-common = "^${LAYERDIR}/"
BBFILE_PRIORITY_image-common = "10"
BBFILE_PATTERN_IGNORE_EMPTY_image-common = "1"
LAYERSERIES_COMPAT_image-common = "sumo"
```

## meta-image-common/conf/machine/beaglebone.conf
```bitbake
MACHINE_EXTRA_RRECOMMENDS = " kernel-modules kernel-devicetree "

EXTRA_IMAGEDEPENDS += "u-boot"

DEFAULTTUNE = "cortexa8hf-neon"
include conf/machine/include/tune-cortexa8.inc

SERIAL_CONSOLE = "115200 ttyO0"

KERNEL_IMAGETYPE = "zImage"
KERNEL_DEVICETREE = "am335x-bone.dtb am335x-boneblack.dtb am335x-bonegreen.dtb"
KERNEL_EXTRA_ARGS += "LOADADDR=${UBOOT_ENTRYPOINT}"

SPL_BINARY = "MLO"
UBOOT_SUFFIX = "img"
UBOOT_MACHINE = "am335x_boneblack_config"
UBOOT_ENTRYPOINT = "0x80008000"
UBOOT_LOADADDRESS = "0x80008000"

MACHINE_FEATURES = "usbgadget usbhost vfat alsa"

IMAGE_BOOT_FILES = "u-boot.${UBOOT_SUFFIX} ${SPL_BINARY}"
```

## meta-image-common/conf/machine/cubieboard2.conf
```bitbake
SOC_FAMILY = "sun7i"
include conf/machine/include/soc-family.inc

EXTRA_IMAGEDEPENDS += "u-boot"

SERIAL_CONSOLE = "115200 ttyS0"

KERNEL_IMAGETYPE = "uImage"
KERNEL_DEVICETREE = "sun7i-a20-cubieboard2.dtb"
KERNEL_EXTRA_ARGS += "LOADADDR=${UBOOT_ENTRYPOINT}"

SPL_BINARY = "u-boot-sunxi-with-spl.bin"
UBOOT_ENV = "boot"
UBOOT_ENV_SUFFIX = "scr"
UBOOT_ENV_BINARY = "${UBOOT_ENV}.${UBOOT_ENV_SUFFIX}"

UBOOT_SUFFIX = "bin"
UBOOT_MACHINE = "Cubieboard2_config"
UBOOT_ENTRYPOINT = "0x40008000"
UBOOT_LOADADDRESS = "0x400080OB00"

MACHINE_EXTRA_RRECOMMENDS = " kernel-modules kernel-devicetree "
MACHINE_FEATURES = "alsa apm keyboard rtc serial screen usbgadget usbhost vfat"

DEFAULTTUNE = "cortexa7hf-neon-vfpv4"
require conf/machine/include/tune-cortexa7.inc

IMAGE_BOOT_FILES = "u-boot.${UBOOT_SUFFIX} ${UBOOT_ENV_BINARY}"
```

## meta-image-common/conf/machine/raspberrypi3.conf
```bitbake
SOC_FAMILY = "rpi"
include conf/machine/include/soc-family.inc

EXTRA_IMAGEDEPENDS += "bcm2835-bootfiles u-boot"

SERIAL_CONSOLE = "115200 ttyS0"

KERNEL_BOOTCMD = "bootm"
KERNEL_IMAGETYPE = "uImage"
KERNEL_DEVICETREE = " \
    bcm2708-rpi-0-w.dtb \
    bcm2708-rpi-b.dtb \
    bcm2708-rpi-b-plus.dtb \
    bcm2709-rpi-2-b.dtb \
    bcm2710-rpi-3-b.dtb \
    bcm2710-rpi-3-b-plus.dtb \
    bcm2708-rpi-cm.dtb \
    bcm2710-rpi-cm3.dtb \
    \
    overlays/hifiberry-amp.dtbo \
    overlays/hifiberry-dac.dtbo \
    overlays/hifiberry-dacplus.dtbo \
    overlays/hifiberry-digi.dtbo \
    overlays/i2c-rtc.dtbo \
    overlays/iqaudio-dac.dtbo \
    overlays/iqaudio-dacplus.dtbo \
    overlays/lirc-rpi.dtbo \
    overlays/pitft22.dtbo \
    overlays/pitft28-resistive.dtbo \
    overlays/pitft35-resistive.dtbo \
    overlays/pps-gpio.dtbo \
    overlays/rpi-ft5406.dtbo \
    overlays/w1-gpio.dtbo \
    overlays/w1-gpio-pullup.dtbo \
    overlays/pi3-disable-bt.dtbo \
    overlays/pi3-miniuart-bt.dtbo \
    overlays/vc4-kms-v3d.dtbo \
    "
KERNEL_EXTRA_ARGS += "LOADADDR=0x00008000"

UBOOT_MACHINE = "rpi_3_32b_config"

MACHINE_EXTRA_RRECOMMENDS = "kernel-modules kernel-devicetree linux-firmware-raspbian-bcm43430 linux-firmware-raspbian-bcm43455"
MACHINE_FEATURES = "apm usbhost keyboard vfat ext2 screen touchscreen alsa bluetooth wifi sdio"

DEFAULTTUNE = "cortexa7thf-neon-vfpv4"
require conf/machine/include/tune-cortexa7.inc

IMAGE_BOOT_FILES = "bcm2835-bootfiles/* u-boot.bin;kernel7.img boot.scr"
```

## meta-image/meta-cetacean-image/recipes-image/cetacean-image/cetacean-image.wks
```
# The --active flag makes direct.py set legacy_boot (using parted) instead of set correct GUID type for EFI System Partition.
# Therefore, we use --part-type EF00 (which makes direct.py runs 'sgdisk --typecode= EF00') to set correct GUID.
part /boot --fixed-size 64M --source multi-bootimg-efi --sourceparams="loader=systemd-boot" --label BOOT --align 1024 --part-type EF00

part --source rootfs --fixed-size 256M --sourceparams="rootfs=true,boot-title=ROOTFS-1" --fstype=squashfs --label ROOTFS1 --align 1024 --use-uuid
part --source rootfs --fixed-size 256M --sourceparams="rootfs=true,boot-title=ROOTFS-2" --fstype=squashfs --label ROOTFS2 --align 1024 --use-uuid

part --fixed-size 128M --fstype=ext4 --label DATA --align 1024 --use-uuid

bootloader --ptable gpt --timeout=1 --append="rootwait rootfstype=squashfs console=ttyS0,115200 console=tty0"
```

## meta-image/meta-lizard-image/conf/layer.conf
```bitbake
# We have a conf and classes directory, add to BBPATH
BBPATH .= ":${LAYERDIR}"

# We have recipes-* directories, add to BBFILES
BBFILES += "${LAYERDIR}/recipes-*/*/*.bb        \
            ${LAYERDIR}/recipes-*/*/*.bbappend  \
            "

BBFILE_COLLECTIONS += "lizard-image"
BBFILE_PATTERN_lizard-image = "^${LAYERDIR}/"
BBFILE_PRIORITY_lizard-image = "10"

LAYERSERIES_COMPAT_lizard-image = "sumo"
```

## meta-image/meta-lizard-image/recipes-image/lizard-image/lizard-image.wks
```
# The disk layout used is:
#    0                      -> 8*1024                           - reserverd
#    8*1024                 ->                                  - arm combined spl/u-boot or aarch64 spl
#    40*1024                ->                                  - aarch64 u-boot
#    2048*1024              -> BOOT_SPACE                       - bootloader and kernel

part u-boot --source rawcopy --sourceparams="file=u-boot-sunxi-with-spl.bin" --no-table --align 8
part /boot  --source bootimg-partition --fstype=vfat --label BOOT --active --align 2048 --size 16
part /      --source rootfs --fstype=ext4 --label ROOTFS-1 --align 4 --size 160M
part /      --source rootfs --fstype=ext4 --label ROOTFS-2 --align 4 --size 160M
```

## meta-image/meta-mushroom-image/recipes-image/mushroom-image/mushroom-image.wks
```
# Raspberry Pi. Boot files are located in the first vfat partition.

part /boot  --source bootimg-partition --fstype=vfat --label BOOT --active --align 4096 --size 20
part /      --source rootfs --fstype=ext4 --label ROOTFS-1 --align 4 --size 256M
part /      --source rootfs --fstype=ext4 --label ROOTFS-2 --align 4 --size 256M
part /data  --fstype=ext4 --label DATA --align 4 --size 128M
```

## meta-image/meta-rodent-image/recipes-image/rodent-flasher-image/rodent-flasher-image.wks
```
part /boot --source bootimg-partition --fstype=vfat --label BOOT --active --align 4 --size 16
part / --source rootfs --fstype=ext4 --label ROOTFS --align 4
```

## meta-private/conf/layer.conf
```bitbake
# We have a conf and classes directory, add to BBPATH
BBPATH .= ":${LAYERDIR}"

# We have recipes-* directories, add to BBFILES
BBFILES += "${LAYERDIR}/recipes-*/*/*.bb        \
            ${LAYERDIR}/recipes-*/*/*.bbappend  \
            "

BBFILE_COLLECTIONS += "private"
BBFILE_PATTERN_private = "^${LAYERDIR}/"
BBFILE_PRIORITY_private = "20"

# To prevent warning "No bb files matched BBFILE_PATTERN_private..."
BBFILE_PATTERN_IGNORE_EMPTY_private = "1"

include ${LAYERDIR}/private.conf
```

## meta-private/meta-cetacean-image/conf/layer.conf
```bitbake
# We have a conf and classes directory, add to BBPATH
BBPATH .= ":${LAYERDIR}"

# We have recipes-* directories, add to BBFILES
BBFILES += "${LAYERDIR}/recipes-*/*/*.bb        \
            ${LAYERDIR}/recipes-*/*/*.bbappend  \
            "

BBFILE_COLLECTIONS += "private-cetacean-image"
BBFILE_PATTERN_private-cetacean-image = "^${LAYERDIR}/"
BBFILE_PRIORITY_private-cetacean-image = "20"
BBFILE_PATTERN_IGNORE_EMPTY_private-cetacean-image = "1"
LAYERSERIES_COMPAT_private-cetacean-image = "sumo"

include ${LAYERDIR}/../meta/conf/private-cetacean-image.conf
```

## meta-private/meta-lizard-image/conf/layer.conf
```bitbake
# We have a conf and classes directory, add to BBPATH
BBPATH .= ":${LAYERDIR}"

# We have recipes-* directories, add to BBFILES
BBFILES += "${LAYERDIR}/recipes-*/*/*.bb        \
            ${LAYERDIR}/recipes-*/*/*.bbappend  \
            "

BBFILE_COLLECTIONS += "private-lizard-image"
BBFILE_PATTERN_private-lizard-image = "^${LAYERDIR}/"
BBFILE_PRIORITY_private-lizard-image = "20"
BBFILE_PATTERN_IGNORE_EMPTY_private-lizard-image = "1"
LAYERSERIES_COMPAT_private-lizard-image = "sumo"

include ${LAYERDIR}/../meta/conf/private-lizard-image.conf
```

## meta-private/meta-mushroom-image/conf/layer.conf
```bitbake
# We have a conf and classes directory, add to BBPATH
BBPATH .= ":${LAYERDIR}"

# We have recipes-* directories, add to BBFILES
BBFILES += "${LAYERDIR}/recipes-*/*/*.bb        \
            ${LAYERDIR}/recipes-*/*/*.bbappend  \
            "

BBFILE_COLLECTIONS += "private-mushroom-image"
BBFILE_PATTERN_private-mushroom-image = "^${LAYERDIR}/"
BBFILE_PRIORITY_private-mushroom-image = "20"
BBFILE_PATTERN_IGNORE_EMPTY_private-mushroom-image = "1"
LAYERSERIES_COMPAT_private-mushroom-image = "sumo"

include ${LAYERDIR}/../meta/conf/private-mushroom-image.conf
```

## meta-private/meta-rodent-image/conf/layer.conf
```bitbake
# We have a conf and classes directory, add to BBPATH
BBPATH .= ":${LAYERDIR}"

# We have recipes-* directories, add to BBFILES
BBFILES += "${LAYERDIR}/recipes-*/*/*.bb        \
            ${LAYERDIR}/recipes-*/*/*.bbappend  \
            "

BBFILE_COLLECTIONS += "private-rodent-image"
BBFILE_PATTERN_private-rodent-image = "^${LAYERDIR}/"
BBFILE_PRIORITY_private-rodent-image = "20"

BBFILE_PATTERN_IGNORE_EMPTY_private-rodent-image = "1"

include ${LAYERDIR}/../meta/conf/private-rodent-image.conf
```
